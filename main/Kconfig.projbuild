## main/Kconfig.projbuild
```kconfig
menu "Project Configuration"

    menu "WiFi Configuration"
        config WIFI_SSID
            string "WiFi SSID"
            default ""
            help
              The SSID (network name) of the WiFi access point to connect to.

        config WIFI_PASSWORD
            string "WiFi Password"
            default ""
            help
              The password for the WiFi network.
              It is strongly recommended to change this from the default value
              for security reasons.

        config WIFI_MAX_RETRY
            int "Maximum WiFi Connection Retries"
            default 5
            range 1 100
            help
              Maximum number of retries when attempting to connect to the WiFi network.
              The connection attempt will be aborted after this many failures.

    endmenu

    menu "MQTT Configuration"

        config MQTT_BROKER_URI
            string "MQTT Broker URI"
            default ""
            help
              The URI of the MQTT broker to connect to.
              Supported schemes:
                mqtt://   - Plain TCP (e.g. mqtt://192.168.1.1:1883)
                mqtts://  - TLS encrypted  (e.g. mqtts://example.com:8883)
                ws://     - WebSocket      (e.g. ws://example.com:8083/mqtt)
                wss://    - WebSocket+TLS  (e.g. wss://example.com:8084/mqtt)

        config MQTT_USERNAME
            string "MQTT Username"
            default ""
            help
              Username for MQTT broker authentication.
              Leave empty if the broker does not require authentication.

        config MQTT_PASSWORD
            string "MQTT Password"
            default ""
            help
              Password for MQTT broker authentication.
              Leave empty if the broker does not require authentication.
              It is strongly recommended to change this from the default value
              for security reasons.

        config MQTT_CLIENT_ID
            string "MQTT Client ID"
            default ""
            help
              Unique client identifier sent to the broker.
              Leave empty to auto-generate an ID based on the chip MAC address
              (recommended when deploying multiple devices).

        config MQTT_KEEPALIVE
            int "MQTT Keep-alive Interval (seconds)"
            default 60
            range 10 3600
            help
              Interval in seconds at which the client sends PING requests to the
              broker to keep the connection alive. The broker will close the
              connection if no message is received within 1.5x this period.

    endmenu

    menu "ESP-NOW Configuration"

        config ESPNOW_PMK
            string "ESP-NOW Primary Master Key (PMK)"
            default ""
            help
              Primary Master Key for ESP-NOW encryption (16 characters).
              Leave empty to disable encryption.
              All nodes in the same ESP-NOW network should use the same PMK.

        config ESPNOW_HEARTBEAT_TIMEOUT_S
            int "Heartbeat Timeout (seconds)"
            default 60
            range 10 600
            help
              If no heartbeat is received from a node within this period,
              the node will be marked as offline.

        config ESPNOW_HEARTBEAT_CHECK_S
            int "Heartbeat Check Interval (seconds)"
            default 10
            range 5 120
            help
              Interval at which the gateway scans the node table to detect
              nodes that have exceeded the heartbeat timeout.

    endmenu

    menu "SNTP Configuration"

        config SNTP_SERVER
            string "NTP Server"
            default "pool.ntp.org"
            help
              Hostname of the NTP server used for time synchronization.

        config SNTP_TIMEZONE
            string "POSIX Timezone String"
            default "CST-8"
            help
              POSIX timezone string. Examples:
              "UTC0" for UTC, "CST-8" for China Standard Time (UTC+8),
              "EST5EDT" for US Eastern with DST.

        config SNTP_SYNC_INTERVAL
            int "Sync Interval (minutes)"
            default 1
            range 1 1440
            help
              How often (in minutes) the device re-synchronizes its clock
              with the NTP server after the initial sync.

    endmenu

    menu "Display Configuration"

        config DISPLAY_PIN_MOSI
            int "MOSI GPIO"
            default 11
            help
              SPI MOSI pin connected to e-Paper DIN.

        config DISPLAY_PIN_CLK
            int "CLK GPIO"
            default 12
            help
              SPI Clock pin connected to e-Paper CLK.

        config DISPLAY_PIN_CS
            int "CS GPIO"
            default 10
            help
              Chip Select pin connected to e-Paper CS.

        config DISPLAY_PIN_DC
            int "DC GPIO"
            default 13
            help
              Data/Command pin connected to e-Paper DC.

        config DISPLAY_PIN_RST
            int "RST GPIO"
            default 14
            help
              Reset pin connected to e-Paper RST.

        config DISPLAY_PIN_BUSY
            int "BUSY GPIO"
            default 4
            help
              Busy status pin connected to e-Paper BUSY.

        config DISPLAY_PIN_PWR
            int "PWR GPIO (-1 to disable)"
            default 5
            range -1 48
            help
              Power control pin connected to e-Paper PWR.
              Set to -1 if the display has no power control pin.

        config DISPLAY_REFRESH_INTERVAL
            int "Dashboard Refresh Interval (seconds)"
            default 60
            range 30 3600
            help
              How often the sensor dashboard is refreshed on the e-Paper display.
              Minimum recommended is 30 seconds to preserve display lifespan.

    endmenu

    menu "Weather Configuration"

        config WEATHER_API_KEY
            string "QWeather API Key"
            default ""
            help
              API key for QWeather service. Required for weather data.
              Obtain from https://console.qweather.com

        config WEATHER_LOCATION
            string "Weather Location"
            default ""
            help
              Location for weather queries. Can be a QWeather LocationID
              (e.g. 101010100) or longitude,latitude coordinates
              (e.g. 116.41,39.92).

        config WEATHER_API_HOST
            string "QWeather API Host"
            default "devapi.qweather.com"
            help
              API host for QWeather. Use devapi.qweather.com for free tier
              or api.qweather.com for paid tier.
    
        config WEATHER_REFRESH_MIN
            int "Weather Refresh Interval (minutes)"
            default 30
            range 10 1440
            help
              How often to fetch weather data from the QWeather API.
              Minimum 10 minutes to avoid excessive API calls.

    endmenu

    menu "Web Server Configuration"

        config WEB_SERVER_ENABLE
            bool "Enable Web Server"
            default y
            help
              Enable the embedded web server for device monitoring and configuration.

        config WEB_SERVER_PORT
            int "HTTP Server Port"
            default 80
            range 1 65535
            depends on WEB_SERVER_ENABLE
            help
              Port number for the HTTP server.

        config WEB_SERVER_MAX_CONN
            int "Maximum Concurrent Connections"
            default 4
            range 1 8
            depends on WEB_SERVER_ENABLE
            help
              Maximum number of simultaneous HTTP connections.

        config WEB_ADMIN_USERNAME
            string "Admin Username"
            default "admin"
            depends on WEB_SERVER_ENABLE
            help
              Default username for web interface authentication.
              Can be changed at runtime via the web interface.

        config WEB_ADMIN_PASSWORD
            string "Admin Password"
            default "admin"
            depends on WEB_SERVER_ENABLE
            help
              Default password for web interface authentication.
              Can be changed at runtime via the web interface.
              It is strongly recommended to change this from the default.

        config WEB_AP_SSID_PREFIX
            string "AP Mode SSID Prefix"
            default "ESP32-Gateway"
            depends on WEB_SERVER_ENABLE
            help
              SSID prefix for AP mode. The last 4 hex digits of the MAC address
              will be appended (e.g., ESP32-Gateway-A1B2).

        config WEB_AP_PASSWORD
            string "AP Mode Password"
            default "12345678"
            depends on WEB_SERVER_ENABLE
            help
              Password for the AP mode WiFi network.
              Must be at least 8 characters.

    endmenu


endmenu
```
